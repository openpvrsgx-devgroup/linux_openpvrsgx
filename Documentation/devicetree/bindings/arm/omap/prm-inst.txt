## Documentation/devicetree/bindings/input/touchscreen/tsc2007.txt
```
* Texas Instruments tsc2007 touchscreen controller

Required properties:
- compatible: must be "ti,tsc2007".
- reg: I2C address of the chip.
- ti,x-plate-ohms: X-plate resistance in ohms.

Optional properties:
- generic touch screen properties: see touchscreen binding [2].
- gpios: the interrupt gpio the chip is connected to (through the penirq pin).
  The penirq pin goes to low when the panel is touched.
  (see GPIO binding[1] for more details).
- interrupts: (gpio) interrupt to which the chip is connected
  (see interrupt binding[0]).
- ti,max-rt: maximum pressure resistance above which samples are ignored
  (default: 4095).
- ti,min-x: minimum value reported by X axis ADC (default 0).
- ti,max-x: maximum value reported by X axis ADC (default 4095).
- ti,min-y: minimum value reported by Y axis ADC (default 0).
- ti,max-y: maximum value reported by Y axis ADC (default 4095).
- ti,poll-period: how much time to wait (in milliseconds) before reading again the
  values from the tsc2007 (default 1).

[0]: Documentation/devicetree/bindings/interrupt-controller/interrupts.txt
[1]: Documentation/devicetree/bindings/gpio/gpio.txt
[2]: Documentation/devicetree/bindings/input/touchscreen/touchscreen.txt

Example:
	&i2c1 {
		/* ... */
		tsc2007@49 {
			compatible = "ti,tsc2007";
			reg = <0x49>;
			interrupt-parent = <&gpio4>;
			interrupts = <0x0 0x8>;
			gpios = <&gpio4 0 0>;
			ti,x-plate-ohms = <180>;
			touchscreen-size-x = <640>;
			touchscreen-size-y = <480>;
		};

		/* ... */
	};
```

## Documentation/devicetree/bindings/media/i2c/ov9655.txt
```
* Omnivision OV9655 CMOS sensor

The Omnivision OV9655 sensor support multiple resolutions output, such as
CIF, SVGA, UXGA. It also can support YUV422/420, RGB565/555 or raw RGB
output format.

Required Properties:
- compatible: should be one of
	"ovti,ov9155"
	"ovti,ov9655"
- clocks: reference to the xclk input clock.

Optional Properties:
- reset-gpios: reference to the GPIO connected to the RESETB pin, if any,
		polarity is active low.
- powerdown-gpios: reference to the GPIO connected to the PWDN pin, if any,
		polarity is active high.
- avdd-supply: reference to the analog power supply regulator connected
		to the AVDD pin, if any.
- dvdd-supply: reference to the digital power supply regulator connected
		to the DVDD pin, if any.
- dovdd-supply: reference to the digital I/O power supply regulator
		connected to the DOVDD pin, if any.
- pclk-delay:		clock delay in 2ns steps. Default is 2.
- output-drive:		driver strength. Default is 1.
- clock-noncontinuous	boolean property for pclk output option. Default is 0.


The device node must contain one 'port' child node for its digital output
video port, in accordance with the video interface bindings defined in
Documentation/devicetree/bindings/media/video-interfaces.txt.

Supported Properties:
- bus-width:		bus width of the camera output. Default is 10.
- data-shift:		data shift of the camera output. Default is 2.
- hsync-active:		HSYNC polarity. Default is 0.
- vsync-active:		VSYNC polarity. Default is 0.
- data-active:		data active polarity. Default is 1.
- pclk-sample:		clock sampling edge. Default is 1 (rising).
- slave-mode:		switch to slave mode. Default is 0.

See data sheet for definition of constants.

Example:

&i2c2 {
	ov9655@30 {
		pinctrl-names = "default";
		pinctrl-0 = <&camera_pins>;
		compatible = "ovti,ov9655";
		reg = <0x30>;
		reset-gpios = <&gpio3 2 0>,	/* reset cam_fld = GPIO_98 */
		powerdown-gpios = <&gpio6 7 0>;	/* pwdn cam_wen = GPIO_167 */
		avdd-supply = <&vaux3>;
		clocks = <&isp 0>;	/* cam_clka */

		port {
			ov9655: endpoint {
				remote-endpoint = <&parallel_ep>;
				bus-width = <8>;
				data-shift = <2>;
				hsync-active = <0>;	/* Active low */
				vsync-active = <1>;	/* Active high */
				pclk-sample = <1>;	/* Rising */
			};
		};
	};
};
```

## Documentation/devicetree/bindings/misc/ti,trs3386.txt
```
TI RS232 level shifter additional modem control lines through gpio

Required properties:
- compatible: ti,trs3386
- gpios: list of the gpios matching the mctrl lines, specify <0> if not used
	0: DTR
	1: RTS
	2: DSR
	3: RI
	4: OUT1
	5: OUT2
  NOTEs:
	- the RTS gpio is not required if the UART has a dedicated RTS output
	- <0> entries at the end can be left out
- uart: the uart the tr3386 is connected to for RX/TX

example:

        trs3386 {
                compatible = "ti,trs3386";
                uart = <&uart3>;	/* trs3386 is connected to uart3 */
		gpios = <&gpio1 21 0>,	/* DTR: GPIO_21 */
			<0>;		/* RTS: unused */
        }
```

## Documentation/devicetree/bindings/mmc/ti-txs02612.txt
```
txs02612 SDIO switch

If a txs02612 SDIO switch (and level shifter) is connected
to a sdio/mmc port of a SoC we have effectively two interfaces
as a result. The switch is controlled by a GPIO.

Required properties:

	compatible = “ti,txs02612”

	select-gpio:	the channel select gpio.

	ports:	two new mmc ports. For details check with
		Documentation//devicetree/bindings/mmc/mmc.txt

Optional properties:

	mmc:	phandle to reference the sdio/mmc port of the SoC.
		If the node is a subnode of the mmc port of the SoC
		this phandle can be omitted.

Example:

	mmc-expander {
		compatible = “ti,txs02612”;
		mmc = <&mmc1>;
		select-gpio = <&gpio3 18 0>;	/* gpio3_82 */
		ports {
			eMMC: port@0 {
				reg = <0>;
				bus-width: 8;
				bus-width = <8>;
				non-removable;
			};
			uSD: port@1 {
				reg = <1>;
				bus-width: 4;
				cd-gpios = <&gpio3 13 GPIO_ACTIVE_LOW>;	/* gpio3_77 */
				wp-gpios = <&gpio3 15 GPIO_ACTIVE_HIGH>;	/* gpio3_79 */
			};
	};
```

## Documentation/devicetree/bindings/net/ingenic,ethernet.yaml
```yaml
# SPDX-License-Identifier: GPL-2.0
%YAML 1.2
---
$id: http://devicetree.org/schemas/net/ingenic,ethernet.yaml#
$schema: http://devicetree.org/meta-schemas/core.yaml#

title: Ingenic JZ4730 Ethernet Mac Controller Device Tree Bindings

allOf:
  - $ref: "ethernet-controller.yaml#"

maintainers:
  - H. Nikolaus Schaller <hns@goldelico.com>

properties:
  compatible:
    const: ingenic,jz4730-ethernet

  reg:
    maxItems: 1

  interrupts:
    maxItems: 1

required:
  - compatible
  - reg
  - interrupts

unevaluatedProperties: false

examples:
  - |
    ethernet: ethernet@13100000 {
        compatible = "ingenic,jz4730-ethernet";
        reg = <0x13100000 0x1000>;

        interrupt-parent = <&intc>;
        interrupts = <19>;

        mdio: mdio {
            #address-cells = <1>;
            #size-cells = <0>;
        };
    };

...
```

## Documentation/devicetree/bindings/power/supply/alpha400-mcu.yaml
```yaml
# SPDX-License-Identifier: GPL-2.0
%YAML 1.2
---
$id: "http://devicetree.org/schemas/power/supply/alpha400-mcu.yaml#"
$schema: "http://devicetree.org/meta-schemas/core.yaml#"

title: Skytone Alpha 400 LPC915 MCU driver

maintainers:
  - Daniel Gloeckner <daniel-gl@gmx.net>
  - H. Nikolaus Schaller <hns@computer.org>

description: |
  Support LPC915 MCU found in Skytone Alpha 400 and derivatives

allOf:
  - $ref: power-supply.yaml#

properties:
  compatible:
    enum:
      - skytone,alpha400-mcu

  reg:
    maxItems: 1
    description: integer, I2C address of the MCU.

  power-supplies: true

required:
  - compatible
  - reg

additionalProperties: false

examples:
  - |
    i2c {
        #address-cells = <1>;
        #size-cells = <0>;
        power_controller@28 {
            compatible = "skytone,alpha400-mcu";
            reg = <0x28>;
        };
    };

...
```

## Documentation/devicetree/bindings/power/supply/bq2429x.txt
```
TI bq24296/24297 Li-Ion Charger
===============================

This binding will support the bq24297. It was derived
from a bq24296 driver but is tested with bq24297 only.
There are other ICs in the same family but those have
not been tested. The Monolithic Power Systems mp2624
is very similar to the bq24297.

Required properties:
- compatible: Should contain one of the following:
    * "ti,bq24296"
    * "ti,bq24297"
    * "mps,mp2624"
- reg: integer, i2c address of the device (should be 0x6b).

Optional properties:
- monitored-battery: phandle of the battery
  properties used if defined:
  * voltage-max-design-microvolt (default 4200000)
  * voltage-min-design-microvolt (default 3200000)
  * constant-charge-current-max-microamp
  (default: as defined by boot loader)
  * precharge-current-microamp (default 128000)
  * charge-term-current-microamp (default 128000)
- dc-det: gpio for detecting two different DC sources
  (default: use usb-input-current-microamp only)
- ti,usb-input-current-microamp: default current for USB source
  (default: value as defined by boot loader)
- ti,adp-input-current-microamp: default current for other source
  (default: 2048000)

Required nodes:
- regulators: child node defining exactly two regulators for
  [0] vsys (battery or usb input -> system output) and
  [1] otg (battery input -> usb output).

Example:
-------

bat: battery {
	compatible = "simple-battery", "pyra-battery";
	voltage-min-design-microvolt = <3200000>;
	voltage-max-design-microvolt = <4200000>;
	energy-full-design-microwatt-hours = <22200000>;
	charge-full-design-microamp-hours = <6000000>;
	charge-term-current-microamp = <128000>;
	constant-charge-current-max-microamp = <1000000>;
};

bq24297@6b {
	compatible = "ti,bq24297";
	reg = <0x6b>;
	monitored-battery = <&bat>;	/* provides max-voltage-by-design */
	interrupt-parent = <&gpio99>;
	interrupts = <(1*8+3) IRQ_TYPE_EDGE_FALLING>;   /* P13 */

	regulators {
		vsys_reg: vsys_regulator {
			regulator-compatible = "bq2429x-vsys";
			regulator-name = "vsys";
			regulator-min-microvolt = <3500000>;
			regulator-max-microvolt = <4200000>;
			regulator-always-on;
			regulator-boot-on;
		};

		otg_reg: otg_regulator {
			regulator-compatible = "bq2429x-otg";
			regulator-name = "otg";
			regulator-min-microvolt = <4900000>;
			regulator-max-microvolt = <5100000>;
		};
	};
};
```

## Documentation/devicetree/bindings/power/supply/bq2429x.yaml
```yaml
# SPDX-License-Identifier: GPL-2.0
%YAML 1.2
---
$id: http://devicetree.org/schemas/power/supply/bq2429x.yaml#
$schema: http://devicetree.org/meta-schemas/core.yaml#

title: TI bq24296/24297 and MPS MP2624 Li-Ion Charger with OTG booster

maintainers:
  - H. Nikolaus Schaller <hns@goldelico.com>
  - Nick Elsmore <nicholaselsmore@gmail.com>

description: |+
  This binding will support the bq24296 and bq24297.
  There are other ICs in the same family but those have
  not been addressed.
  The MP2624 is very similar to the bq24297 but not exactly
  identical.
  This chip is used by the OMAP5 based Pyra-Handheld.

properties:
  compatible:
    oneOf:
      - const: mps,mp2624
      - const: ti,bq24296
      - const: ti,bq24297

  reg:
    const: 0x6b

  interrupts:
    minItems: 1

  monitored-battery:
    - description: phandle to the battery node
    - allOf:
      - $ref: /schemas/types.yaml#/definitions/phandle
# QUESTION: how can we formally describe that we support only the following phandle properties and ignore the others?
# QUESTION: should it be comment like for rohm,bd99954.yaml?
# QUESTION: how can we describe the default to be used by the driver if there is no monitored-battery node?
#   - enum:
#     - voltage-max-design-microvolt:
#       - default: 4200000
#     - voltage-min-design-microvolt:
#       - default: 3200000
#     - constant-charge-current-max-microamp:
#       - default: as defined by boot loader
#     - precharge-current-microamp:
#       - default: 128000
#     - charge-term-current-microamp:
#       - default: 128000

  regulators:
    minItems: 2
    maxItems: 2
    type: object
    $ref: regulator.yaml#

    description: |
      two regulator child nodes for
      [0] vsys (battery or usb input -> system output)
      [1] otg (battery input -> usb output).

    patternProperties:
      "^vsys_regulator$":
        type: object
        $ref: regulator.yaml#

      "^otg_regulator$":
        type: object
        $ref: regulator.yaml#

    additionalProperties: false

  dc-det-gpios:
    items:
# QUESTION: how do we specify that it should be connected to a gpio?
      - description: gpio for detecting two different DC sources
      - default: use usb-input-current-microamp only

  ti,usb-input-current-microamp:
    items:
      - description: initial current for USB source (if dc-det is 0)
      - default: value as defined by boot loader

  ti,adp-input-current-microamp:
    items:
      - description: initial current for other source (if dc-det is 1)
      - default: 2048000µA

required:
  - compatible
  - reg
  - interrupts
  - regulators

additionalProperties: false

examples:
  - |
    #include <dt-bindings/interrupt-controller/irq.h>

    bat: battery {
      compatible = "simple-battery", "pyra-battery";
      voltage-min-design-microvolt = <3200000>;
      voltage-max-design-microvolt = <4200000>;
      energy-full-design-microwatt-hours = <22200000>;
      charge-full-design-microamp-hours = <6000000>;
      charge-term-current-microamp = <128000>;
      constant-charge-current-max-microamp = <1000000>;
    };

    bq24297@6b {
      compatible = "ti,bq24297";
      reg = <0x6b>;
      monitored-battery = <&bat>;
      interrupt-parent = <&gpio99>;
      interrupts = <(1*8+3) IRQ_TYPE_EDGE_FALLING>;   /* P13 */
      regulators {
        vsys_reg: vsys_regulator {
          regulator-name = "vsys";
          regulator-min-microvolt = <3500000>;
          regulator-max-microvolt = <4200000>;
          regulator-always-on;
          regulator-boot-on;
        };
        otg_reg: otg_regulator {
          regulator-name = "otg";
          regulator-min-microvolt = <4900000>;
          regulator-max-microvolt = <5100000>;
        };
      };
    };

...
```

## Documentation/devicetree/bindings/sound/pcm1773.yaml
```yaml
# SPDX-License-Identifier: None
%YAML 1.2
---
$id: http://devicetree.org/schemas/bindings/sound/pcm1773.yaml#
$schema: http://devicetree.org/meta-schemas/core.yaml#

title: Texas Instruments pcm1773 DT bindings

maintainers:
  - tbd.

description: |+
  PCM1771 is a simple audio codec that can be enabled
  through a gpio.

properties:
  compatible: ti,pcm1773

examples:
  - |
    audio-codec {
      compatible = "ti,pcm1773";
      enable-gpios = <&gpio4 22 GPIO_ACTIVE_LOW>;
    };

...
```

## Documentation/devicetree/bindings/sound/ts3a225e.txt
```
* TI Autonomous Audio Headset Switch driver.

Required properties:
- compatible: "ti,ts3a225e"
- reg: i2c address (0x3b)

Optional properties:
- interrupt
  if no interrupt is defined, the driver can poll.

Examples:

&i2c5 {
	headset: ts3a225@3b {
		compatible = "ti,ts3a225e";
		reg = <0x3b>;
		interrupt-parent = <&gpio6>;
		interrupts = <1 IRQ_TYPE_LEVEL_LOW>;	/* gpio6_161 */
	};
};
```

## Letux/Debian/defconfig
```kconfig
CONFIG_RD_XZ=y
CONFIG_XZ_DEC_ARMTHUMB=y
CONFIG_DECOMPRESS_XZ=y
CONFIG_NFS_V2=y
CONFIG_F2FS_FS=y
CONFIG_F2FS_CHECK_FS=n
CONFIG_F2FS_FS_POSIX_ACL=y
CONFIG_F2FS_FS_SECURITY=y
CONFIG_F2FS_FS_XATTR=y
```
