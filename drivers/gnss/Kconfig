## drivers/gnss/Kconfig
```kconfig
# SPDX-License-Identifier: GPL-2.0-only
#
# GNSS receiver configuration
#

menuconfig GNSS
	tristate "GNSS receiver support"
	help
	  Say Y here if you have a GNSS receiver (e.g. a GPS receiver).

	  To compile this driver as a module, choose M here: the module will
	  be called gnss.

if GNSS

config GNSS_SERIAL
	tristate

config GNSS_MTK_SERIAL
	tristate "Mediatek GNSS receiver support"
	depends on SERIAL_DEV_BUS
	select GNSS_SERIAL
	help
	  Say Y here if you have a Mediatek-based GNSS receiver which uses a
	  serial interface.

	  To compile this driver as a module, choose M here: the module will
	  be called gnss-mtk.

	  If unsure, say N.

config GNSS_SIRF_SERIAL
	tristate "SiRFstar GNSS receiver support"
	depends on SERIAL_DEV_BUS
	help
	  Say Y here if you have a SiRFstar-based GNSS receiver which uses a
	  serial interface.

	  To compile this driver as a module, choose M here: the module will
	  be called gnss-sirf.

	  If unsure, say N.

config GNSS_UBX_SERIAL
	tristate "u-blox GNSS receiver support"
	depends on SERIAL_DEV_BUS
	select GNSS_SERIAL
	help
	  Say Y here if you have a u-blox GNSS receiver which uses a serial
	  interface.

	  To compile this driver as a module, choose M here: the module will
	  be called gnss-ubx.

	  If unsure, say N.

config GNSS_USB
	tristate "USB GNSS receiver support"
	depends on USB
	help
	  Say Y here if you have a GNSS receiver which uses a USB interface.

	  To compile this driver as a module, choose M here: the module will
	  be called gnss-usb.

	  If unsure, say N.

config GNSS_W2SG0004
	tristate "W2SG00x4 power on/off driver"
	depends on GPIOLIB && SERIAL_DEV_BUS
	help
	  Enable on/off control of W2SG00x4 GPS module connected
	  to some SoC UART to allow powering up/down if the /dev/gnss
	  is opened/closed.

	  It also provides a "rfkill gps" name to control the LNA power.

endif # GNSS
```

## drivers/gpu/drm/mxc-epdc/Kconfig
```kconfig
# SPDX-License-Identifier: GPL-2.0
config DRM_MXC_EPDC
	tristate "i.MX EPD Controller"
	depends on DRM && OF
	depends on (COMPILE_TEST || ARCH_MXC)
	select DRM_KMS_HELPER
	select DRM_KMS_CMA_HELPER
	select DMA_CMA if HAVE_DMA_CONTIGUOUS
	select CMA if HAVE_DMA_CONTIGUOUS
	help
	  Choose this option if you have an i.MX system with an EPDC.

	  If M is selected this module will be called mxc_epdc_drm.
```

## drivers/gpu/drm/pvrsgx/1.14.3841212/Kconfig
```kconfig
menuconfig IMG_PVR_GPU
	bool "IMG PVR GPU Support "
	default n
	help
		Say Y here if you have a IMG GPU on the chip

if IMG_PVR_GPU

config IMG_SGX_5xx
	tristate "SGX-540 or SGX-544"
	default n
	help
	  Say M here if you have a IMG_SGX_5xx on the chip

endif
```

## drivers/gpu/drm/pvrsgx/1.7.862890/Kconfig
```kconfig
#
# Drm device configuration
#
# This driver provides support for the
# Direct Rendering Infrastructure (DRI) in XFree86 4.1.0 and higher.
#

config DRM_INTEL_CDV
	tristate "Intel CDV (load along with IMG driver)"
	depends on DRM && PCI && !DRM_PSB_CDV
	select FB_CFB_COPYAREA
        select FB_CFB_FILLRECT
        select FB_CFB_IMAGEBLIT
        select DRM_KMS_HELPER
        select DRM_TTM
	select ACPI_VIDEO if ACPI
	help
          Choose this option if you have a Cedarview platform.
          If M is selected the module will be called cedarview_gfx.

choice 
	prompt "Build IMG kernel service as "
	depends on DRM_INTEL_CDV
	default DRM_CDV_RELEASE

config DRM_CDV_RELEASE
	bool "Release"
	depends on DRM_INTEL_CDV
	help
	  Build IMG kernel services as release version.

config DRM_CDV_DEBUG
	bool "Debug"
	depends on DRM_INTEL_CDV
	help
	  Build IMG kernel services as debug version.	
endchoice

if DRM_CDV_DEBUG

config DRM_PVR_PDUMP
 	bool "Enable PDump Debug"
 	help
 	  Build the PVR driver with PDUMP feature. At most cases it should be N.

config DRM_PVR_TRACE
	bool "Enable PVR Service Trace"
	help
	  Enable PVR service call trace. If unsure, it should be N.

endif
```

## drivers/gpu/drm/pvrsgx/Kconfig
```kconfig
config SGX
	bool "PowerVR SGX"
	help
	  Support for the PowerVR SGX 3D core.

choice
	prompt "Choose PVR/SGX DDK version"
	depends on SGX
	help
	  Support for the PowerVR SGX 3D core based on DDK code
	  variant as selected.
	
config PVRSGX_1_9_2188537
	bool "DDK 1.9.2253347 (TI)"
	help
	  This version should work on OMAP3530, AM3517

config PVRSGX_1_9_2253347
	bool "DDK 1.9.2253347 (TI)"

config PVRSGX_1_10_2359475
	bool "DDK 1.10.2359475 (TI)"

config PVRSGX_1_13_3341330
	bool "DDK 1.13.3341330 (INGENIC)"

config PVRSGX_1_14_3699939
	bool "DDK 1.14.3699939 (TI)"
	help
	  This version is known to work on DM3730, AM335x, OMAP5

config PVRSGX_1_14_3759903
	bool "DDK 1.14.3759903 (INGENIC)"

config PVRSGX_1_14_3841212
	bool "DDK 1.14.3841212 (SUNXI)"
	help
	  This version should work on JZ4780 at some time

config PVRSGX_1_15_4564147
	bool "DDK 1.15.4564147 (TI)"

config PVRSGX_1_17_4948957
	bool "DDK 1.17.4948957 (TI)"

endchoice

config SGX_DEBUG
	bool "PowerVR SGX build with DEBUG enabled"
	depends on SGX
	help
	  Build for DEBUG.

config SGX_DRM
	bool "PowerVR SGX build with DRM support"
	depends on SGX
	select DRM_LEGACY
	help
	  Build for using DRM infrastructure.
	  Note: this selectes DRM_LEGACY with all its issues.

config SGX_CEDARVIEW
	tristate "PowerVR SGX inside Atom SoC"
	depends on SGX && MATOM
	help
	  Support for the PowerVR SGX 3D core inside Intel Atom D2500/N2600 and more.

config SGX_OMAP
	tristate "PowerVR SGX inside OMAP SoC"
	depends on SGX && (ARCH_OMAP3 || SOC_AM33XX || ARCH_OMAP2PLUS)
	help
	  Support for the PowerVR SGX 3D core inside OMAP SoC.

config SGX_POULSBO
	tristate "PowerVR SGX inside GMA500 SoC"
	depends on SGX && MATOM
	help
	  Support for the PowerVR SGX 3D core inside Intel GMA500 ('Poulsbo') and
	  other Intel IMG based graphics devices.

config SGX_JZ4780
	tristate "PowerVR SGX inside JZ4780 SoC"
	depends on SGX && MACH_JZ4780
	help
	  Support for the PowerVR SGX 3D core inside OMAP SoC.

config SGX_SUNXI
	tristate "PowerVR SGX inside SUNXI SoC"
	depends on SGX && ARCH_SUNXI
	help
	  Support for the PowerVR SGX 3D core inside Allwinner A31 or A83T.

config SGX_GENERIC
	tristate "PowerVR SGX generic driver"
	depends on SGX
	help
	  Support for the PowerVR SGX 3D core inside generic SoC.
```

## drivers/gpu/pvr/Kconfig
```kconfig
menuconfig PVR
	tristate "PowerVR Services"
	depends on FB_OMAP2_DSS

if PVR

choice
	prompt "Build type"
	default PVR_RELEASE
config PVR_RELEASE
	bool "Release"
config PVR_DEBUG
	bool "Debug"
config PVR_TIMING
	bool "Timing"
endchoice

config PVR_DEBUG_EXTRA
	bool "Extra debugging info"
	depends on PVR_DEBUG
	help
	    This enables extra debugging facilities on top of what you
	    get with setting debug build type above. This effectively
	    changes the driver's ABI, so the user space clients using
	    the driver need to be built in debug mode as well.

config PVR_DEBUG_PDUMP
	bool "PDUMP debug support"
	depends on PVR && DEBUG_FS && PVR_DEBUG_EXTRA
	default n
	help
	    This enables Pdump logging.

choice
	prompt "Pdump initial debugging mode"
	depends on PVR_DEBUG_PDUMP
	default PVR_PDUMP_MODE_STANDARD

config PVR_PDUMP_MODE_DISABLED
	bool "Disabled"
	help
	    In this pdump mode, no information will be captured.

config PVR_PDUMP_MODE_STANDARD
	bool "Standard"
	help
	    This PDumpmode catches some of the information generated by both
	    kernel and pvr userspace.

config PVR_PDUMP_MODE_FULL
	bool "Full"
	help
	    This PDumpmode catches all information generated by both kernel
	    and pvr userspace. This mode is needed for allowing Imagination
	    Technologies to run a pdump log through their simulator.

endchoice

config PVR_PDUMP_INITIAL_MAX_FRAME_COUNT
	int "Pdump max frame count"
	range 1 1024
	default 16
	depends on PVR_DEBUG_PDUMP
	help
	    This value sets how many frames will be retained at any time; the oldest
	    frames will be removed first. This value can be set from 1 to 1024.

config PVR_EDM_DEBUG
	depends on PVR
	bool "Enable EDM trace"
	default n
	help
	    This will print the micro kernel (EDM) tracing buffer in case
	    of a HW recovery event. You also need a micro kernel that was
	    configured to generate this trace.

config PVR_TRACE_CMD
	depends on PVR
	bool "Enable GPU command tracing"
	default n
	help
	    This will enable a lightweight tracer of commands submitted
	    to the GPU.

	    Besides the command type the trace output will provide the
	    timestamp, id and name of the submitting process and a
	    a snapshots of the synchronization counters related to the
	    given command.

	    The trace can help for example in debugging dead-lock
	    situations caused by circular lock dependencies.

config PVR_TRACE_CMD_BUF_SHIFT
	int "Command tracing buf size"
	range 1 10
	default 3
	depends on PVR_TRACE_CMD
	help
	    Select the number of pages (as a power of 2) set aside for
	    the command trace buffer.
	    Examples:
		    1  -> 4kB
		    3  -> 32kB
		    10 -> 4MB

config PVR_NO_HARDWARE
	bool
	default n

config PVR_FORCE_CLOCKS_ON
	bool "Force clocks on"
	depends on !PVR_NO_HARDWARE
	default n

config PVR_EXAMPLES
	tristate "Example code"
	default n

endif
```

## drivers/net/ethernet/ingenic/Kconfig
```kconfig
# SPDX-License-Identifier: GPL-2.0-only
#
# IBM device configuration.
#

config NET_VENDOR_INGENIC
	bool "INGENIC devices"
	default y
	help
	  If you have a network (Ethernet) card belonging to this class, say Y.

if NET_VENDOR_INGENIC

config INGENIC_ETH_JZ4730
	tristate "Ingenic JZ4730 Ethernet support"
	help
	  This driver supports the MII Ethernet controller in the
	  and jz4730 SoC.

	  To compile this driver as a module, choose M here. The module will
	  be called jz4730_eth.

endif # NET_VENDOR_INGENIC
```

## drivers/power/Kconfig
```kconfig
# SPDX-License-Identifier: GPL-2.0-only
source "drivers/power/reset/Kconfig"
source "drivers/power/supply/Kconfig"

config POWER_ALPHA400
	tristate "Alpha400 power controller support"
	depends on I2C
	help
	  This adds support for the Skytone Alpha 400 and similars
	  (like Letux 400). It provides battery status and system
	  power off.
```

## drivers/staging/pvr/Kconfig
```kconfig
config SGX
	bool "PowerVR SGX"
	---help---
	  Support for the PowerVR SGX 3D core.

config SGX_114
	bool "PowerVR SGX DDK 1.14"
	depends on SGX
	---help---
	  Support for the PowerVR SGX 3D core based on DDK 1.14 code.
	  Default is the DDK 1.9/10 code.

config SGX_DEBUG
	bool "PowerVR SGX build with DEBUG enabled"
	depends on SGX
	---help---
	  Build for DEBUG.

config SGX_DRM
	bool "PowerVR SGX build with DRM support"
	depends on SGX
	---help---
	  Build for using DRM infrastructure.

config SGX_CEDARVIEW
	tristate "PowerVR SGX inside Atom SoC"
	depends on SGX_114 && MATOM
	---help---
	  Support for the PowerVR SGX 3D core inside Intel Atom D2500/N2600 and more.

config SGX_OMAP
	tristate "PowerVR SGX inside OMAP SoC"
	depends on (SGX && (ARCH_OMAP3 || SOC_AM33XX)) || (SGX_114 && ARCH_OMAP2PLUS)
	---help---
	  Support for the PowerVR SGX 3D core inside OMAP SoC.

config SGX_POULSBO
	tristate "PowerVR SGX inside GMA500 SoC"
	depends on SGX_114 && MATOM
	---help---
	  Support for the PowerVR SGX 3D core inside Intel GMA500 ('Poulsbo') and
	  other Intel IMG based graphics devices.

config SGX_JZ4780
	tristate "PowerVR SGX inside JZ4780 SoC"
	depends on SGX_114 && MACH_JZ4780
	---help---
	  Support for the PowerVR SGX 3D core inside OMAP SoC.

config SGX_SUNXI
	tristate "PowerVR SGX inside SUNXI SoC"
	depends on SGX_114 && ARCH_SUNXI
	---help---
	  Support for the PowerVR SGX 3D core inside Allwinner A31 or A83T.

config SGX_GENERIC
	tristate "PowerVR SGX generic driver"
	depends on SGX_114
	---help---
	  Support for the PowerVR SGX 3D core inside generic SoC.
```

## drivers/staging/rtl8723cs-new/Kconfig
```kconfig
config RTL8723CS_NEW
	tristate "Realtek RTL8723CS SDIO or SPI WiFi driver (2017)"
	depends on WLAN && MMC && CFG80211
	select WIRELESS_EXT
	select WEXT_PRIV
	help
	  Help message of RTL8723CS
```

## sound/soc/jz4740/Kconfig
```kconfig
# SPDX-License-Identifier: GPL-2.0-only
config SND_JZ4740_SOC_I2S
	tristate "SoC Audio (I2S protocol) for Ingenic JZ4740 SoC"
	depends on MIPS || COMPILE_TEST
	depends on HAS_IOMEM
	select REGMAP_MMIO
	select SND_SOC_GENERIC_DMAENGINE_PCM
	help
	  Say Y if you want to use I2S protocol and I2S codec on Ingenic JZ4740
	  based boards.

config SND_JZ4780_SOC_CI20
	tristate "SoC Audio support for ci20"
	depends on SND_JZ4740_SOC_I2S
	select SND_SOC_JZ4780_CODEC
	help
	  Say Y if you want to add support for ASoC audio on the ci20.
```
