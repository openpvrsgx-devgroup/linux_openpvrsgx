/*
 * Copyright (C) 2014 H. Nikolaus Schaller <hns@goldelico.com>
 *
 * This program is free software; you can redistribute it and/or modify
 * it under the terms of the GNU General Public License version 2 as
 * published by the Free Software Foundation.
 */

#include "omap3-beagle-xm-ab.dts"

/ {

	/* overwrite device model */
	model = "BeagleBoard XM / GTA04";

	madc-hwmon {
		compatible = "ti,twl4030-madc-hwmon";
	};

};

&vaux1 { /* connected to EXP_VDD (3V3) rail of P13 */
	regulator-name = "exp_vdd";
	regulator-min-microvolt = <1800000>;
	regulator-max-microvolt = <3000000>;
};
