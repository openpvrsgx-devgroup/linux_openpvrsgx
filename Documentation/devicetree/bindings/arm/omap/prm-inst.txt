## Documentation/devicetree/bindings/arm/omap/prm-inst.txt
```
OMAP PRM instance bindings

Power and Reset Manager is an IP block on OMAP family of devices which
handle the power domains and their current state, and provide reset
handling for the domains and/or separate IP blocks under the power domain
hierarchy.

Required properties:
- compatible:	Must be one of:
		"ti,am3-prm-inst"
		"ti,am4-prm-inst"
		"ti,omap4-prm-inst"
		"ti,omap5-prm-inst"
		"ti,dra7-prm-inst"
- reg:		Contains PRM instance register address range
		(base address and length)

Optional properties:
- #reset-cells:	Should be 1 if the PRM instance in question supports resets.

Example:

prm_dsp2: power-controller@1b00 {
	compatible = "ti,dra7-prm-inst";
	reg = <0x1b00 0x40>;
	#reset-cells = <1>;
};
```

## Documentation/devicetree/bindings/display/gdepaper.txt
```
Good Display/Waveshare e-ink displays

Required properties:
- compatible:		"gooddisplay,wfi0190cz22" for 2.7" b/w/red displays,
			replace part number for other displays.
			Use "gooddisplay,generic_epaper" to manually configure
			the display's resolution etc.

- dc-gpios:		Data Command
- reset-gpios:		Reset pin
- busy-gpios:		Busy pin
- spi-speed-hz		SPI baud rate to use to when talking to the display

The node for this driver must be a child node of a SPI controller, hence
all mandatory properties described in ../spi/spi-bus.txt must be specified.

Example:

	epaper@0{
		compatible = "gooddisplay,gdew042z15";
		reg = <0>;
		spi-speed-hz = <1000000>;
		spi-max-frequency = <6000000>;
		dc-gpios = <&gpio 25 GPIO_ACTIVE_HIGH>;
		reset-gpios = <&gpio 17 GPIO_ACTIVE_HIGH>;
		busy-gpios = <&gpio 24 GPIO_ACTIVE_LOW>;
	};
```

## Documentation/devicetree/bindings/display/imx/fsl,mxc-epdc.yaml
```yaml
# SPDX-License-Identifier: (GPL-2.0-only OR BSD-2-Clause)
%YAML 1.2
---
$id: http://devicetree.org/schemas/display/imx/fsl,mxc-epdc.yaml#
$schema: http://devicetree.org/meta-schemas/core.yaml#

title: Freescale i.MX6 EPDC

maintainers:
  - Andreas Kemnade <andreas@kemnade.info>

description: |
  The EPDC is a controller for handling electronic paper displays found in
  i.MX6 SoCs.

properties:
  compatible:
    enum:
      - fsl,imx6sl-epdc
      - fsl,imx6sll-epdc

  reg:
    maxItems: 1

  clocks:
    items:
      - description: Bus clock
      - description: Pixel clock

  clock-names:
    items:
      - const: axi
      - const: pix

  interrupts:
    maxItems: 1

  vscan-holdoff:
    $ref: /schemas/types.yaml#/definitions/uint32
    maxItems: 1

  sdoed-width:
    $ref: /schemas/types.yaml#/definitions/uint32
    maxItems: 1

  sdoed-delay:
    $ref: /schemas/types.yaml#/definitions/uint32
    maxItems: 1

  sdoez-width:
    $ref: /schemas/types.yaml#/definitions/uint32
    maxItems: 1

  sdoez-delay:
    $ref: /schemas/types.yaml#/definitions/uint32
    maxItems: 1

  gdclk-hp-offs:
    $ref: /schemas/types.yaml#/definitions/uint32
    maxItems: 1

  gdsp-offs:
    $ref: /schemas/types.yaml#/definitions/uint32
    maxItems: 1

  gdoe-offs:
    $ref: /schemas/types.yaml#/definitions/uint32
    maxItems: 1

  gdclk-offs:
    $ref: /schemas/types.yaml#/definitions/uint32
    maxItems: 1

  num-ce:
    $ref: /schemas/types.yaml#/definitions/uint32
    maxItems: 1

  timing:
    $ref: /display/panel/panel-timing.yaml#

  DISPLAY-supply:
    description:
      A couple of +/- voltages automatically powered on in a defintive order

  VCOM-supply:
    description: compensation voltage

  V3P3-supply:
    description: V3P3 supply

  epd-thermal-zone:
    description: 
      Zone to get temperature of the EPD from, practically ambient temperature.



required:
  - compatible
  - reg
  - clocks
  - clock-names
  - interrupts
  - vscan-holdoff
  - sdoed-width
  - sdoed-delay
  - sdoez-width
  - sdoez-delay
  - gdclk-hp-offs
  - gdsp-offs
  - gdoe-offs
  - gdclk-offs
  - num-ce

additionalProperties: false

examples:
  - |
    #include <dt-bindings/clock/imx6sl-clock.h>
    #include <dt-bindings/interrupt-controller/arm-gic.h>

    epdc: epdc@20f4000 {
        compatible = "fsl,imx6sl-epdc";
        reg = <0x020f4000 0x4000>;
        interrupts = <0 97 IRQ_TYPE_LEVEL_HIGH>;
        clocks = <&clks IMX6SL_CLK_EPDC_AXI>, <&clks IMX6SL_CLK_EPDC_PIX>;
        clock-names = "axi", "pix";

        pinctrl-names = "default";
        pinctrl-0 = <&pinctrl_epdc0>;
        V3P3-supply = <&V3P3_reg>;
        VCOM-supply = <&VCOM_reg>;
        DISPLAY-supply = <&DISPLAY_reg>;
        epd-thermal-zone = "epd-thermal";

        vscan-holdoff = <4>;
        sdoed-width = <10>;
        sdoed-delay = <20>;
        sdoez-width = <10>;
        sdoez-delay = <20>;
        gdclk-hp-offs = <562>;
        gdsp-offs = <662>;
        gdoe-offs = <0>;
        gdclk-offs = <225>;
        num-ce = <3>;
        status = "okay";

        timing {
                clock-frequency = <80000000>;
                hactive = <1448>;
                hback-porch = <16>;
                hfront-porch = <102>;
                hsync-len = <28>;
                vactive = <1072>;
                vback-porch = <4>;
                vfront-porch = <4>;
                vsync-len = <2>;
        };
    };
...
```

## Documentation/devicetree/bindings/display/panel/boe,btl507212-w677l.txt
```
BOE BTL507212-W677L Panel
=========================

Required properties:
- compatible: "boe,btl507212-w677l"

Optional properties:
- label: a symbolic name for the panel
- backlight: phandle of the backlight device
- gpios: a list of gpios connected to the panel
    [0]: reset
    [1]: regulator

Required nodes:
- port: video port for DSI input

Example
-------

lcd: btl507212-w677l@0 {
	label = "lcd";
	backlight = <&backlight>;
	gpios = <&gpio6 16 0>;	/* goip6_176 = panel reset */

	port {
		lcd_in: endpoint {
			remote-endpoint = <&dsi_out_ep>;
		};
	};
};
```

## Documentation/devicetree/bindings/display/panel/boe,btl507212-w677l.yaml
```yaml
# SPDX-License-Identifier: GPL-2.0
%YAML 1.2
---
$id: http://devicetree.org/schemas/display/panel/boe,btl507212-w677l.yaml#
$schema: http://devicetree.org/meta-schemas/core.yaml#

title: BOE BTL507212-W677L Panel

maintainers:
  - H. Nikolaus Schaller <hns@goldelico.com>

description: |+
  This BOE BTL507212-W677L Panel is a 4 lane DSI panel.
  Its controller is an Orise OTM1283A.
  It is used by the Pyra Handheld computer.

properties:
  compatible:
    const: boe,btl507212-w677l

  label:
    items:
      - description: an optional label

  backlight:
    items:
      $ref: /schemas/types.yaml#/definitions/phandle

  gpios:
    items:
      - description: the panel reset gpio

  port:
    items:
      - description: the port

required:
  - compatible
  - port

examples:
  - |+
    lcd: btl507212-w677l@0 {
      label = "lcd";
      backlight = <&backlight>;
      gpios = <&gpio6 16 0>;	/* goip6_176 = panel reset */

      port {
        lcd_in: endpoint {
          remote-endpoint = <&dsi_out_ep>;
        };
      };
    };

...
```

## Documentation/devicetree/bindings/gnss/wi2wi,w2sg0004.txt
```
Wi2Wi W2SG0004 GPS module connected through UART

Should be a subnode of the SoC UART it is connected to.

Required properties:
- compatible:	must be
	"wi2wi,w2sg0004"
- enable-gpio:	the GPIO that controls the module's power toggle
	input. A positive impulse of sufficent length toggles the
	power state.

Optional properties:
- lna-supply:	an (optional) LNA regulator that is enabled together with the GPS receiver

Example:

&uart2 {
	w2sg0004: gps {
		compatible = "wi2wi,w2sg0004";
		lna-supply = <&vsim>;   /* LNA regulator */
		enable-gpios = <&gpio5 17 GPIO_ACTIVE_HIGH>;    /* GPIO_145: trigger for turning on/off w2sg0004 */
        };
};
```

## Documentation/devicetree/bindings/gpu/img,pvrsgx.txt
```
Imagination PVR/SGX GPU

Only the Imagination SGX530, SGX540 and SGX544 GPUs are currently covered by this binding.

Required properties:
- compatible:	Should be one of
		"ti,omap3-sgx530-121", "img,sgx530-121", "img,sgx530", "img,sgx5"; - BeagleBoard ABC, OpenPandora 600MHz
		"ti,omap3-sgx530-125", "img,sgx530-125", "img,sgx530", "img,sgx5"; - BeagleBoard XM, GTA04, OpenPandora 1GHz
		"ti,am3517-sgx530-125", "img,sgx530-125", "img,sgx530", "img,sgx5";
		"ti,am335x-sgx530-125", "img,sgx530-125", "img,sgx530", "img,sgx5"; - BeagleBone Black
		"ti,omap4-sgx540-120", "img,sgx540-120", "img,sgx540", "img,sgx5"; - Pandaboard (ES)
		"ti,omap4-sgx544-112", "img,sgx544-112", "img,sgx544", "img,sgx5";
		"ti,omap5-sgx544-116", "img,sgx544-116", "img,sgx544", "img,sgx5"; - OMAP5 UEVM, Pyra Handheld
		"ti,dra7-sgx544-116", "img,sgx544-116", "img,sgx544", "img,sgx5";
		"ti,am3517-sgx530-?", "img,sgx530-?", "img,sgx530", "img,sgx5";
		"ti,am43xx-sgx530-?", "img,sgx530-?", "img,sgx530", "img,sgx5";
		"ti,ti81xx-sgx530-?", "img,sgx530-?", "img,sgx530", "img,sgx5";
		"img,jz4780-sgx540-?", "img,sgx540-?", "img,sgx540", "img,sgx5"; - CI20
		"allwinner,sun8i-a83t-sgx544-?", "img,sgx544-116", "img,sgx544", "img,sgx5"; - Banana-Pi-M3 (Allwinner A83T)
		"intel,poulsbo-gma500-sgx535", "img,sgx535-116", "img,sgx535", "img,sgx5"; - Atom Z5xx
		"intel,medfield-gma-sgx540", "img,sgx540-116", "img,sgx540", "img,sgx5"; - Atom Z24xx
		"intel,cedarview-gma3600-sgx545", "img,sgx545-116", "img,sgx545", "img,sgx5"; - Atom N2600, D2500

		The "ti,omap..." entries are needed temporarily to handle SoC
		specific builds of the kernel module.

		In the long run, only the "img,sgx..." entry should suffice
		to match a generic driver for all architectures and driver
		code can dynamically find out on which SoC it is running.


- reg:		Physical base address and length of the register area.
- interrupts:	The interrupt numbers.

/ {
	ocp {
		sgx_module: target-module@56000000 {
			compatible = "ti,sysc-omap4", "ti,sysc";
			reg = <0x5600fe00 0x4>,
			      <0x5600fe10 0x4>;
			reg-names = "rev", "sysc";
			ti,sysc-midle = <SYSC_IDLE_FORCE>,
					<SYSC_IDLE_NO>,
					<SYSC_IDLE_SMART>;
			ti,sysc-sidle = <SYSC_IDLE_FORCE>,
					<SYSC_IDLE_NO>,
					<SYSC_IDLE_SMART>;
			clocks = <&gpu_clkctrl OMAP5_GPU_CLKCTRL 0>;
			clock-names = "fck";
			#address-cells = <1>;
			#size-cells = <1>;
			ranges = <0 0x56000000 0x2000000>;

			gpu@fe00 {
				compatible = "ti,omap-omap5-sgx544-116", "img,sgx544-116", "img,sgx544", "img,sgx5";
				reg = <0xfe00 0x200>;
				interrupts = <GIC_SPI 21 IRQ_TYPE_LEVEL_HIGH>;
			};
		};
	};
};
```

## Documentation/devicetree/bindings/gpu/img,pvrsgx.yaml
```yaml
# SPDX-License-Identifier: GPL-2.0-only OR BSD-2-Clause
%YAML 1.2
---
$id: http://devicetree.org/schemas/gpu/img,pvrsgx.yaml#
$schema: http://devicetree.org/meta-schemas/core.yaml#

title: Imagination PVR/SGX GPU

maintainers:
  - H. Nikolaus Schaller <hns@goldelico.com>

description: |+
  This binding describes the Imagination SGX5 series of 3D accelerators which
  are found in several different SoC like TI OMAP, Sitara, Ingenic JZ4780,
  Allwinner A83, and Intel Poulsbo and CedarView and more.

  For an extensive list see: https://en.wikipedia.org/wiki/PowerVR#Implementations

properties:
  $nodename:
    pattern: '^gpu@[a-f0-9]+$'
  compatible:
    oneOf:
      - description: SGX530-121 based SoC
        items:
          - enum:
              - ti,omap3-sgx530-121 # BeagleBoard A/B/C, OpenPandora 600MHz and similar
          - const: img,sgx530-121
          - const: img,sgx530

      - description: SGX530-125 based SoC
        items:
          - enum:
              - ti,am3352-sgx530-125 # BeagleBone Black
              - ti,am3517-sgx530-125
              - ti,am4-sgx530-125
              - ti,omap3-sgx530-125 # BeagleBoard XM, GTA04, OpenPandora 1GHz and similar
              - ti,ti81xx-sgx530-125
          - const: img,sgx530-125
          - const: img,sgx530

      - description: SGX531 based SoC
        items:
          - enum:
              - csr,atlas7-sgx531
              - csr,prima2-sgx531
          - const: img,sgx531

      - description: SGX535-116 based SoC
        items:
          - const: intel,poulsbo-gma500-sgx535 # Atom Z5xx
          - const: img,sgx535-116
          - const: img,sgx535

      - description: SGX540-116 based SoC
        items:
          - const: intel,medfield-gma-sgx540 # Atom Z24xx
          - const: img,sgx540-116
          - const: img,sgx540

      - description: SGX540-120 based SoC
        items:
          - enum:
              - samsung,s5pv210-sgx540-120
              - ti,omap4-sgx540-120 # Pandaboard, Pandaboard ES and similar
          - const: img,sgx540-120
          - const: img,sgx540

      - description: SGX540-130 based SoC
        items:
          - enum:
              - ingenic,jz4780-sgx540-130 # CI20
          - const: img,sgx540-130
          - const: img,sgx540

      - description: SGX544-112 based SoC
        items:
          - const: ti,omap4470-sgx544-112
          - const: img,sgx544-112
          - const: img,sgx544

      - description: SGX544-115 based SoC
        items:
          - enum:
              - allwinner,sun6i-a31-sgx544-115
              - allwinner,sun6i-a31s-sgx544-115
              - allwinner,sun8i-a83t-sgx544-115 # Banana-Pi-M3 (Allwinner A83T) and similar
          - const: img,sgx544-115
          - const: img,sgx544

      - description: SGX544-116 based SoC
        items:
          - enum:
              - ti,dra7-sgx544-116 # DRA7
              - ti,omap5-sgx544-116 # OMAP5 UEVM, Pyra Handheld and similar
          - const: img,sgx544-116
          - const: img,sgx544

      - description: SGX545 based SoC
        items:
          - const: intel,cedarview-gma3600-sgx545 # Atom N2600, D2500
          - const: img,sgx545-116
          - const: img,sgx545

  reg:
    maxItems: 1

  interrupts:
    maxItems: 1

  interrupt-names:
    maxItems: 1
    items:
      - const: sgx

  clocks:
    maxItems: 4

  clock-names:
    maxItems: 4
    items:
      - const: core
      - const: sys
      - const: mem
      - const: hyd

  sgx-supply: true

  power-domains:
    maxItems: 1

  resets:
    maxItems: 1

required:
  - compatible
  - reg
  - interrupts

additionalProperties: false

allOf:
  - if:
      properties:
        compatible:
          contains:
            enum:
              - "ti,am3352-sgx530-125"
              - "ti,am3517-sgx530-125"
              - "ti,am4-sgx530-125"
              - "ti,omap3-sgx530-125"
              - "ti,ti81xx-sgx530-125"
    then:
      properties:
        clocks:
          minItems: 2
          maxItems: 2

        clock-names:
          items:
            - const: core
            - const: sys

      required:
        - clocks
        - clock-names

  - if:
      properties:
        compatible:
          contains:
            enum:
              - "ti,omap4-sgx544-112"
              - "ti,omap5-sgx544-116"
              - "ti,dra7-sgx544-116"
    then:
      properties:
        clocks:
          minItems: 1
          maxItems: 1

        clock-names:
          items:
            - const: core

      required:
        - clocks
        - clock-names

examples:
  - |+
    #include <dt-bindings/interrupt-controller/arm-gic.h>

    gpu: gpu@fe00 {
      compatible = "ti,omap5-sgx544-116", "img,sgx544-116", "img,sgx544";
      reg = <0xfe00 0x200>;
      interrupts = <GIC_SPI 21 IRQ_TYPE_LEVEL_HIGH>;
    };

...
```

## Documentation/devicetree/bindings/input/pandora-nub.txt
```
* Pandora Nub (vsense)

Required SoC Specific Properties:
- compatible: should be one of the following
   - "pandora,pandora-nub":

Optional Properties specific to linux:
- vcc-supply: the vcc supply
- reg: the i2c address (<0x66> or <0x67>)
- gpios: the interrupt gpio and the (shared) reset gpio

Example:
	vsense-left@66 {
		compatible = "pandora,pandora-nub";
		vcc-supply = <&vaux4>;
		reg = <0x66>;
		gpios = <&gpio6 1 GPIO_ACTIVE_LOW>,	/* GPIO_161 */
			<&gpio5 28 GPIO_ACTIVE_LOW>;	/* GPIO_156 */
		interrupt-parent = <&gpio6>;
		interrupts = <1 IRQ_TYPE_EDGE_RISING>;	/* GPIO_161 low-to-high edge */
	};
```
