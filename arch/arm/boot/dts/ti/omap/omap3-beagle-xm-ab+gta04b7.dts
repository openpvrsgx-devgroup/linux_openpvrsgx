/*
 * Copyright (C) 2011 Texas Instruments Incorporated - http://www.ti.com/
 *
 * This program is free software; you can redistribute it and/or modify
 * it under the terms of the GNU General Public License version 2 as
 * published by the Free Software Foundation.
 */

#include "omap3-beagle-xm-ab+gta04.dts"
#include "omap3-beagle+b7.dtsi"

/ {
	/* overwrite device model */
	model = "BeagleBoard XM AB / GTA04 b7 / Neo900 Prototype";
};
