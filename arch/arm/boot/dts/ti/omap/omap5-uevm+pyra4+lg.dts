/*
 * Copyright (C) 2014 OpenPandora - http://www.pyra-handheld.com/
 *
 * This program is free software; you can redistribute it and/or modify
 * it under the terms of the GNU General Public License version 2 as
 * published by the Free Software Foundation.
 */

/* we atart with the omap5-pyra tree */

#include "omap5-uevm+pyra4.dts"

&lcd {
	compatible = "lg,lh500wf1";

/* there is no ldo2_reg!	vdds_foo-supply = <&ldo2_reg>; */
/* does not work as expected:	vdds_foo-supply = <&dsi1_panel_power>; */

	gpios =
		<&gpio6 16 0>,	/* goip6_176 = display reset */
		<&gpio3 18 0>;	/* gpio3_82 = enable DC/DC */
};
