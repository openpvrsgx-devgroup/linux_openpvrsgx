/*
 * Copyright (C) 2014 H. Nikolaus Schaller <marek@goldelico.com>
 *
 * This program is free software; you can redistribute it and/or modify
 * it under the terms of the GNU General Public License version 2 as
 * published by the Free Software Foundation.
 */

#include "omap3-gta04a4.dts"
#include "omap3-gta04+b2.dtsi"
