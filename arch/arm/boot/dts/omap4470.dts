// SPDX-License-Identifier: GPL-2.0-only
/*
 * Device Tree Source for OMAP4470 SoC
 *
 * Copyright (C) 2012 Texas Instruments Incorporated - http://www.ti.com/
 *
 * This file is licensed under the terms of the GNU General Public License
 * version 2.  This program is licensed "as is" without any warranty of any
 * kind, whether express or implied.
 */
#include "omap4460.dtsi"

&sgx {
	compatible = "img,sgx544-112", "img,sgx544", "ti,omap-omap4-sgx544-112";
};
