/*
 * Copyright (C) 2014 H. Nikolaus Schaller <hns@goldelico.com>
 *
 * This program is free software; you can redistribute it and/or modify
 * it under the terms of the GNU General Public License version 2 as
 * published by the Free Software Foundation.
 */

#include "omap3-beagle-xm+gta04.dts"

/ {

	/* overwrite device model */
	model = "BeagleBoard XM / GTA04 b7 / Neo900 Prototype";

	memory {
		device_type = "memory";
                reg = <0x80000000 0x40000000>; /* 1 GB */
	};

};
