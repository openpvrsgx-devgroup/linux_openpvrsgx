/*
 * Copyright (C) 2014 H. Nikolaus Schaller <hns@goldelico.com>
 *
 * This program is free software; you can redistribute it and/or modify
 * it under the terms of the GNU General Public License version 2 as
 * published by the Free Software Foundation.
 */

#include "omap3-beagle+gta04.dts"
#include "omap3-beagle+b4.dtsi"

/ {

	/* overwrite device model */
	model = "BeagleBoard + GTA04 b4";
};
